## meta-oe-alliance/meta-brands/meta-dags/conf/machine/dags7335.conf
```bitbake
include conf/machine/include/dags-oem.inc

CHIPSET = "bcm7335"

PREFERRED_VERSION_linux-dags = "3.9.7"
PREFERRED_VERSION_linux-libc-headers = "3.9.7"

MACHINE_FEATURES += " fan"
```
